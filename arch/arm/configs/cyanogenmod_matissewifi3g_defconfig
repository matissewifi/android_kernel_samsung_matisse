## arch/arm/configs/cyanogenmod_matissewifi3g_defconfig
```kconfig
CONFIG_ARCH_MSM8226_3G_WIFI

CONFIG_SEC_MATISSEWIFI_COMMON=y
CONFIG_MACH_MATISSEWIFI_OPEN=y
CONFIG_MACH_MATISSE3G_OPEN=y

CONFIG_CONFIG_HAPTIC_ISA1200=y

CONFIG_SENSORS_SX9500=y
CONFIG_SENSORS_SX9500_INIT_TOUCH_THRESHOLD=3000
CONFIG_SENSORS_SX9500_NORMAL_TOUCH_THRESHOLD=15
CONFIG_SENSORS_GRIP_ADJDET=y
```

## arch/arm/configs/cyanogenmod_matissewifi_defconfig
```kconfig
CONFIG_ARCH_MSM8226_3G_WIFI

CONFIG_SEC_MATISSEWIFI_COMMON=y
CONFIG_MACH_MATISSEWIFI_OPEN=y
```

## arch/arm/configs/cyanogenmod_milletwifi_defconfig
```kconfig
CONFIG_ARCH_MSM8226_3G_WIFI

CONFIG_MACH_MILLETWIFI_OPEN=y
CONFIG_SEC_MILLET_PROJECT=y
CONFIG_SEC_MILLETWIFI_COMMON=y

CONFIG_FB_MSM_MDSS_SDC_WXGA_PANEL=y
CONFIG_TOUCHSCREEN_MMS252=y

CONFIG_INPUT_POLLDEV=y
```

## arch/arm/configs/msm8226-sec_kexec_defconfig
```kconfig
CONFIG_KEXEC=y
CONFIG_KEXEC_HARDBOOT=y
CONFIG_IKCONFIG=y
CONFIG_IKCONFIG_PROC=y
CONFIG_LOG_BUF_SHIFT=21
CONFIG_PROC_DEVICETREE=y
CONFIG_SEC_LOG_LAST_KMSG=y
```

## arch/arm/configs/msm8226-sec_matisselte_defconfig
```kconfig
# SSWAP
CONFIG_SWAP=y
CONFIG_FRONTSWAP=y
CONFIG_ZSMALLOC_NEW=y
CONFIG_PGTABLE_MAPPING=y
CONFIG_ZSWAP=y
CONFIG_DIRECT_RECLAIM_FILE_PAGES_ONLY=y
CONFIG_INCREASE_MAXIMUM_SWAPPINESS=y
CONFIG_FIX_INACTIVE_RATIO=y
CONFIG_TIGHT_PGDAT_BALANCE=y
CONFIG_VNSWAP=y
CONFIG_SWAP_ENABLE_READAHEAD=n

#variant defconfig
CONFIG_SEC_MATISSE_PROJECT=y
CONFIG_SEC_MATISSELTE_COMMON=y
CONFIG_MACH_MATISSELTE_OPEN=y

CONFIG_FB_MSM_MDSS_TC_DSI2LVDS_WXGA_PANEL=y
CONFIG_TOUCHSCREEN_ATMEL_MXT1188S=y

CONFIG_CONFIG_HAPTIC_ISA1200=y
CONFIG_VIBRATOR_UPDATE=y

CONFIG_SENSORS_SX9500=y
CONFIG_SENSORS_SX9500_INIT_TOUCH_THRESHOLD=3000
CONFIG_SENSORS_SX9500_NORMAL_TOUCH_THRESHOLD=15
CONFIG_SENSORS_GRIP_ADJDET=y

CONFIG_ARCH_MSM8926_LTE=y
```

## arch/arm/configs/msm8226-sec_matissewifi_defconfig
```kconfig
#SWAP
CONFIG_SWAP=y
CONFIG_FRONTSWAP=y
CONFIG_ZSMALLOC_NEW=y
CONFIG_PGTABLE_MAPPING=y
CONFIG_ZSWAP=y
CONFIG_DIRECT_RECLAIM_FILE_PAGES_ONLY=y
CONFIG_INCREASE_MAXIMUM_SWAPPINESS=y
CONFIG_FIX_INACTIVE_RATIO=y
CONFIG_TIGHT_PGDAT_BALANCE=y
CONFIG_VNSWAP=y
CONFIG_SWAP_ENABLE_READAHEAD=n

#Variant defconfig
CONFIG_SEC_MATISSE_PROJECT=y
CONFIG_SEC_MATISSEWIFI_COMMON=y
CONFIG_MACH_MATISSEWIFI_OPEN=y

#Display
CONFIG_FB_MSM_MDSS_TC_DSI2LVDS_WXGA_PANEL=y
CONFIG_TOUCHSCREEN_ATMEL_MXT1188S=y

#IR Blaster
CONFIG_IR_REMOCON_MC96FR116=y

#Connection Type
CONFIG_ARCH_MSM8226_3G_WIFI=y
```

## arch/arm/configs/msm8226-sec_milletlte_defconfig
```kconfig
#SWAP
CONFIG_SWAP=y
CONFIG_FRONTSWAP=y
CONFIG_ZSMALLOC_NEW=y
CONFIG_PGTABLE_MAPPING=y
CONFIG_ZSWAP=y
CONFIG_DIRECT_RECLAIM_FILE_PAGES_ONLY=y
CONFIG_INCREASE_MAXIMUM_SWAPPINESS=y
CONFIG_FIX_INACTIVE_RATIO=y
CONFIG_TIGHT_PGDAT_BALANCE=y
CONFIG_VNSWAP=y
CONFIG_SWAP_ENABLE_READAHEAD=n

#Variant defconfig
CONFIG_SEC_MILLET_PROJECT=y
CONFIG_MACH_MILLETLTE_OPEN=y
CONFIG_SEC_MILLETLTE_COMMON=y

#Display
CONFIG_FB_MSM_MDSS_SDC_WXGA_PANEL=y
CONFIG_ESD_ERR_FG_RECOVERY=y
CONFIG_TOUCHSCREEN_MMS252=y

#Vibrator
CONFIG_MSM_VIBRATOR=y
CONFIG_CONFIG_HAPTIC_ISA1200=y
CONFIG_VIBRATOR_UPDATE=y

#IR Blaster
CONFIG_IR_REMOCON_MC96FR116=y

#Other
CONFIG_INPUT_POLLDEV=y
CONFIG_SND_SOC_MAX98504=y
CONFIG_HID_ZAGG=y

#Connection Type
CONFIG_ARCH_MSM8926_LTE=y
```

## arch/arm/configs/noselinux_defconfig
```kconfig
CONFIG_AUDIT=n
CONFIG_SECURITY_SELINUX_BOOTPARAM=y
CONFIG_SECURITY_SELINUX_BOOTPARAM_VALUE=0
```
